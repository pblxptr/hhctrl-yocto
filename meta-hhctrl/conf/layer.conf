## meta-hhctrl/conf/layer.conf
```bitbake
# We have a conf and classes directory, add to BBPATH
BBPATH .= ":${LAYERDIR}"

# We have recipes-* directories, add to BBFILES
BBFILES += "${LAYERDIR}/recipes-*/*/*.bb \
            ${LAYERDIR}/recipes-*/*/*.bbappend"


BBFILE_COLLECTIONS += "meta-hhctrl"

BBFILE_PATTERN_meta-hhctrl = "^${LAYERDIR}/"
BBFILE_PRIORITY_meta-hhctrl = "6"

LAYERDEPENDS_meta-hhctrl = "core"
LAYERSERIES_COMPAT_meta-hhctrl = "hardknott honister kirkstone"

BBFILES_DYNAMIC += " \
    raspberrypi:${LAYERDIR}/dynamic-layers/raspberrypi/*/*/*.bb \
    raspberrypi:${LAYERDIR}/dynamic-layers/raspberrypi/*/*/*.bbappend \
"
```
